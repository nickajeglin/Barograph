//--------------CONFIG--------------
float elevCorr = 4241;  //elevation correction in Pa, use difference between altimeter setting and station pressure: https://www.weather.gov/epz/wxcalc_altimetersetting
float maxP = 104000;    //in Pa
float minP = 98000;     //in Pa
byte units = 1;         //units on startup: 0=conventional, 1=metric
int graphHeight = 135;  //in pixels
int yShift = 9;         // in pixels
#define SCALECOLOR 0xB000   //color picker here: http://www.barth-dev.de/online/rgb565-color-picker/
#define TXTCOLOR  0x451F

//hardware libraries
#include <Wire.h>
#include <Adafruit_MPL3115A2.h>
#include "SPI.h"
#include "Adafruit_GFX.h"
#include "Adafruit_ILI9341.h"
#define TFT_DC 9
#define TFT_CS 10
Adafruit_ILI9341 tft = Adafruit_ILI9341(TFT_CS, TFT_DC);
Adafruit_MPL3115A2 baro = Adafruit_MPL3115A2();

//declare backlight control I/O
const byte blPin = 3;
volatile int backLight = 255;
const byte buttonPin = 5;

const int ledPin = 7;

//unit change button
const byte unitPin = 4;

//button debounce vars
long lastDebounceTime = 0;
long debounceDelay = 300;

float pressureStack[144] = {}; //make the array to hold pressure data, fill with zeros.
//144 steps at 20 minute refresh time is a 2880 minute (48 hr) graph with 20 minute resolution.
//with 2px per step, we get 10 minutes/px, and 288px per 48 hrs, leaving some space for graph labels

float deltaPressure = 5000; //5k is arbitrary, it just needs to be out of range to prevent display on cold start
float deltaPressure3h = 5000;
float pascals;


unsigned long timer1 = 0; //5 min timer for value update
unsigned long timer2 = 0; //20 minute timer for graph/array update
unsigned long timer3 = 0; //5 sec timer for emergency alert

//bitmaps... is there a better place to put these? Because this looks dumb
//also, a transformation matrix/function would halve the number of bitmaps we need.
//or we could replace most of them with gfx primitives, but I'm lazy

//'Falling', 80x80px
const unsigned char falling [] PROGMEM = {
  0x00, 0x00, 0x78, 0x00, 0x00, 0x00, 0x00, 0x00, 0x00, 0x00, 0x00, 0x00, 0xfc, 0x00, 0x00, 0x00,
  0x00, 0x00, 0x00, 0x00, 0x00, 0x00, 0xfe, 0x00, 0x00, 0x00, 0x00, 0x00, 0x00, 0x00, 0x00, 0x03,
  0xff, 0x00, 0x00, 0x00, 0x00, 0x00, 0x00, 0x00, 0x00, 0x07, 0xff, 0x80, 0x00, 0x00, 0x00, 0x00,
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  0x01, 0xff, 0xff, 0xff, 0xff, 0xff, 0x00, 0x00, 0x00, 0x00, 0x03, 0xff, 0xff, 0xff, 0xff, 0xff
};
// 'RapidlyFalling', 80x80px
const unsigned char rapidlyFalling [] PROGMEM = {
  0x00, 0x00, 0x78, 0x00, 0x00, 0x00, 0x00, 0x00, 0x00, 0x00, 0x00, 0x00, 0xfc, 0x00, 0x00, 0x00,
  0x00, 0x00, 0x00, 0x00, 0x00, 0x00, 0xfe, 0x00, 0x00, 0x00, 0x00, 0x00, 0x00, 0x00, 0x00, 0x03,
  0xff, 0x00, 0x00, 0x00, 0x00, 0x00, 0x00, 0x00, 0x00, 0x07, 0xff, 0x80, 0x00, 0x00, 0x00, 0x00,
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  0x01, 0xff, 0xff, 0xff, 0xff, 0xff, 0x00, 0x00, 0x00, 0x00, 0x03, 0xff, 0xff, 0xff, 0xff, 0xff
};
// 'RapidlyRising', 80x80px
const unsigned char rapidlyRising [] PROGMEM = {
  0x00, 0x00, 0x00, 0x00, 0x03, 0xff, 0xff, 0xff, 0xff, 0xff, 0x00, 0x00, 0x00, 0x00, 0x01, 0xff,
  0xff, 0xff, 0xff, 0xff, 0x00, 0x00, 0x00, 0x00, 0x01, 0xff, 0xff, 0xff, 0xff, 0xff, 0x00, 0x00,
  0x00, 0x00, 0x00, 0xff, 0xff, 0xff, 0xff, 0xff, 0x00, 0x00, 0x00, 0x00, 0x00, 0x7f, 0xff, 0xff,
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  0x00, 0x00, 0x00, 0x00, 0x00, 0x00, 0x00, 0x00, 0x78, 0x00, 0x00, 0x00, 0x00, 0x00, 0x00, 0x00
};
// 'Rising', 80x80px
const unsigned char rising [] PROGMEM = {
  0x00, 0x00, 0x00, 0x00, 0x03, 0xff, 0xff, 0xff, 0xff, 0xff, 0x00, 0x00, 0x00, 0x00, 0x01, 0xff,
  0xff, 0xff, 0xff, 0xff, 0x00, 0x00, 0x00, 0x00, 0x01, 0xff, 0xff, 0xff, 0xff, 0xff, 0x00, 0x00,
  0x00, 0x00, 0x00, 0xff, 0xff, 0xff, 0xff, 0xff, 0x00, 0x00, 0x00, 0x00, 0x00, 0x7c, 0x00, 0x00,
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  0x00, 0x00, 0x00, 0x00, 0x00, 0x00, 0x00, 0x00, 0x78, 0x00, 0x00, 0x00, 0x00, 0x00, 0x00, 0x00
};
// 'steady', 80x80px
const unsigned char steady [] PROGMEM = {
  0x00, 0x00, 0x00, 0x00, 0x00, 0x00, 0x00, 0x00, 0x00, 0x00, 0x00, 0x00, 0x00, 0x00, 0x00, 0xc0,
  0x00, 0x00, 0x00, 0x00, 0x00, 0x00, 0x00, 0x00, 0x00, 0xe0, 0x00, 0x00, 0x00, 0x00, 0x00, 0x00,
  0x00, 0x00, 0x00, 0xf0, 0x00, 0x00, 0x00, 0x00, 0x00, 0x00, 0x00, 0x00, 0x00, 0xf8, 0x00, 0x00,
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  0x00, 0xc0, 0x00, 0x00, 0x00, 0x00, 0x00, 0x00, 0x00, 0x00, 0x00, 0x00, 0x00, 0x00, 0x00, 0x00
};
// 'vRapidlyFalling', 80x80px
const unsigned char vRapidlyFalling [] PROGMEM = {
  0x00, 0x00, 0x00, 0xff, 0xff, 0xff, 0xff, 0x00, 0x00, 0x00, 0x00, 0x00, 0x00, 0xff, 0xff, 0xff,
  0xff, 0x00, 0x00, 0x00, 0x00, 0x00, 0x00, 0xff, 0xff, 0xff, 0xff, 0x00, 0x00, 0x00, 0x00, 0x00,
  0x00, 0xff, 0xff, 0xff, 0xff, 0x00, 0x00, 0x00, 0x00, 0x00, 0x00, 0xff, 0xff, 0xff, 0xff, 0x00,
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  0x03, 0xc0, 0x00, 0x00, 0x00, 0x00, 0x00, 0x00, 0x00, 0x00, 0x01, 0x80, 0x00, 0x00, 0x00, 0x00
};
// 'vRapidlyRising', 80x80px
const unsigned char vRapidlyRising [] PROGMEM = {
  0x00, 0x00, 0x00, 0x00, 0x01, 0x80, 0x00, 0x00, 0x00, 0x00, 0x00, 0x00, 0x00, 0x00, 0x03, 0xc0,
  0x00, 0x00, 0x00, 0x00, 0x00, 0x00, 0x00, 0x00, 0x07, 0xe0, 0x00, 0x00, 0x00, 0x00, 0x00, 0x00,
  0x00, 0x00, 0x0f, 0xf0, 0x00, 0x00, 0x00, 0x00, 0x00, 0x00, 0x00, 0x00, 0x1f, 0xf8, 0x00, 0x00,
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  0xff, 0xff, 0xff, 0x00, 0x00, 0x00, 0x00, 0x00, 0x00, 0xff, 0xff, 0xff, 0xff, 0x00, 0x00, 0x00
};

void setup() {

  //set up hardwares
  tft.begin();
  tft.setRotation(1);
  baro.begin();

  //set up backlight control I/O
  pinMode(blPin, OUTPUT);
  pinMode(buttonPin, INPUT_PULLUP);
  analogWrite(blPin, 255);

  pinMode(ledPin, OUTPUT);

  //set up unit change button
  pinMode(unitPin, INPUT_PULLUP);

  //get and print initial data
  pressureStack[143] = baro.getPressure() + elevCorr;
  printReadings(units, pressureStack[143]);

}

void loop() {


  //check if user wants to change the backlight
  if ( (millis() - lastDebounceTime) > debounceDelay) {
    if (digitalRead(buttonPin) == LOW) {
      changeBL();
      lastDebounceTime = millis();
    }
  }

  //or if they want to change the display units
  if ( (millis() - lastDebounceTime) > debounceDelay) {
    if (digitalRead(unitPin) == LOW) {
      units++;
      if (units > 1) {
        units = 0;
      }
      //Serial.println(units);
      pascals = baro.getPressure() + elevCorr;
      printReadings(units, pascals);
      lastDebounceTime = millis();
    }
  }

  //check for crashing pressure and blink a LED if it's happening
  if (millis() - timer3 > 10000) {
    if ( (-200) < deltaPressure && deltaPressure <= (-116)) {
      blinky(2, 500);
      timer3 = millis();
      return;
    }
    else if ( (-2000) < deltaPressure && deltaPressure <= (-200)) {
      blinky(5, 200);
      timer3 = millis();
      return;
    }
  }

  //every 5 minutes acquire/print temp and pressure
  if (millis() - timer1 > 300000) {
    pascals = baro.getPressure() + elevCorr;
    printReadings(units, pascals);

    //every 20 minutes log, display, and graph pressure/delta pressure
    if (millis() - timer2 > 1200000) {
      //shift array left
      int i = 0;
      for (i = 0; i < 143; i++) {
        pressureStack[i] = pressureStack[i + 1];
      }
      //and tack on the latest pressure
      pressureStack[143] = pascals;
      //calculate pressure change and reprint all to screen
      deltaPressure = pressureStack[143] - pressureStack[140];
      deltaPressure3h = pressureStack[143] - pressureStack[134];
      printReadings(units, pascals);
      timer2 = millis();
    }
    timer1 = millis();
  }
}

void clearScreen() {
  tft.fillScreen(ILI9341_BLACK);
}

void changeBL() {
  backLight = backLight + 51;
  if (backLight > 255) {
    backLight = 0;
  }
  analogWrite(blPin, backLight);
}

void printReadings(int units, float pascals) {
  clearScreen();
  tft.setCursor(0, 0);
  tft.setTextColor(TXTCOLOR);  tft.setTextSize(3);
  switch (units) {
    case 0:
      tft.print(pascals / 3386.4, 2); tft.println(F(" inHg"));
      break;
    case 1:
      tft.print(pascals / 100, 2); tft.println(F(" hPa"));
      break;
  }
  printDeltaP();
  printDeltaP3h();
  drawScale();
  tickMarks(3, 5); //args: (hours, height)
  tickMarks(6, 8);
  scaleMarks(500, 5); //args: (Pa, length)
  scaleMarks(1000, 8);
  drawGraph();
  drawIcon();
}

//blob this into printReadings()?
void printDeltaP() {
  tft.setTextColor(TXTCOLOR);  tft.setTextSize(3); tft.setCursor(0, 26);
  if (deltaPressure < -116) {
    tft.setTextColor(0xF882);
  }
  if (units == 0) {
    if (abs(deltaPressure) > 2000) {
      tft.println(F("--- inHg/h"));
      return;
    }
    tft.print(deltaPressure / 3386.4, 2); tft.println(F(" inHg/h"));
  }
  else {
    if (abs(deltaPressure) > 400) {
      tft.println(F("--- Pa/h"));
      return;
    }
    tft.print(deltaPressure, 0); tft.println(F(" Pa/h"));
  }
}

void printDeltaP3h() {
  tft.setTextColor(TXTCOLOR);  tft.setTextSize(3); tft.setCursor(0, 52);
  if (deltaPressure3h < -348) {
    tft.setTextColor(0xF882);
  }
  if (units == 0) {
    if (abs(deltaPressure3h) > 2000) {
      tft.println(F("--- inHg/3h"));
      return;
    }
    tft.print(deltaPressure3h / 3386.4, 2); tft.println(F(" inHg/3h"));
  }
  else {
    if (abs(deltaPressure3h) > 400) {
      tft.println(F("--- Pa/3h"));
      return;
    }
    tft.print(deltaPressure3h, 0); tft.println(F(" Pa/3h"));
  }
}

void drawIcon() {
  if ( -116 < deltaPressure && deltaPressure <= -50) {
    tft.drawBitmap(230, 5, falling, 80, 80, TXTCOLOR);
    return;
  }
  else if ( (-200) < deltaPressure && deltaPressure <= (-116)) {
    tft.drawBitmap(230, 5, rapidlyFalling, 80, 80, 0xF882);
    return;
  }
  else if ( (-2000) < deltaPressure && deltaPressure <= (-200)) {
    tft.drawBitmap(230, 5, vRapidlyFalling, 80, 80, 0xF882);
    return;
  }
  else if ( 50 <= deltaPressure && deltaPressure < 116) {
    tft.drawBitmap(230, 5, rising, 80, 80, TXTCOLOR);
    return;
  }
  else if ( 116 <= deltaPressure && deltaPressure < 200) {
    tft.drawBitmap(230, 5, rapidlyRising, 80, 80, TXTCOLOR);
    return;
  }
  else if ( 200 <= deltaPressure && deltaPressure < 2000) {
    tft.drawBitmap(230, 5, vRapidlyRising, 80, 80, TXTCOLOR);
    return;
  }
  tft.drawBitmap(230, 5, steady, 80, 80, TXTCOLOR);
}

void tickMarks(int t, int h) { //t in hours
  int x = 319;
  int deltax = t * 6;
  for (x = 319; x > 31; x = x - deltax) {
    tft.drawLine(x, 239 - yShift, x, 239 - yShift - h, SCALECOLOR);
  }
}

void scaleMarks(int p, int len) { //t in hours
  int y = 239 - yShift;
  int deltay = map(p, 0, maxP - minP, 0, graphHeight);
  for (y = 239 - yShift; y > 239 - graphHeight - yShift + 5; y = y - deltay) {
    tft.drawLine(31, y, 31 + len, y, SCALECOLOR);
    tft.drawLine(319, y, 319 - len, y, SCALECOLOR);
  }
}

void drawScale() {
  //write limits of pressure scale in consistent units
  tft.setTextColor(SCALECOLOR);  tft.setTextSize(1);
  if (units == 0) {
    tft.setCursor(1, 233 - yShift);
    tft.print(minP / 3386.4, 2);
    tft.setCursor(1, 239 - graphHeight - yShift);
    tft.print(maxP / 3386.4, 2);
    tft.setCursor(1, 233 - (graphHeight / 2) - yShift);
    tft.print((minP + (maxP - minP) / 2) / 3386.4, 2);
  }
  else {
    tft.setCursor(10, 233 - yShift);
    tft.print(minP / 100, 0);
    tft.setCursor(4, 239 - graphHeight - yShift);
    tft.print(maxP / 100, 0);
    tft.setCursor(4, 236 - (graphHeight / 2) - yShift);
    tft.print((minP + (maxP - minP) / 2) / 100, 0);
  }
  //draw horizontal lines
  tft.drawLine(31, 239 - graphHeight - yShift, 319, 239 - graphHeight - yShift, SCALECOLOR);
  tft.drawLine(31, 239 - yShift, 319, 239 - yShift, SCALECOLOR);
  //draw vertical lines, and label 24, 48 hrs
  tft.drawLine(319, 239 - graphHeight - yShift, 319, 239 - yShift, SCALECOLOR);
  tft.drawLine(175, 239 - graphHeight - yShift, 175, 239 - yShift, SCALECOLOR);
  tft.drawLine(31, 239 - graphHeight - yShift, 31, 239 - yShift, SCALECOLOR);
  tft.setCursor(175, 232);
  tft.print(24);
  tft.setCursor(31, 232);;
  tft.print(48);
}

void drawGraph() {
  int i = 143;
  int deltax = 2;
  int x = 319;
  for (i = 143; i > 0 ; i--) {
    int p1 =  map(pressureStack[i], minP, maxP, 0, graphHeight);
    int p2 =  map(pressureStack[i - 1], minP, maxP, 0, graphHeight);
    if (pressureStack[i - 1] != 0) {
      tft.drawLine(x, 239 - p1 - yShift, x - deltax, 239 - p2 - yShift, 0x07E0);
    }
    x = x - deltax;
  }
}

void blinky(int qty, int waitTime) {
  for (int i = 0; i <= qty; i++) {
    digitalWrite(ledPin, HIGH);
    delay(waitTime);
    digitalWrite(ledPin, LOW);
    delay(waitTime);
  }
}
